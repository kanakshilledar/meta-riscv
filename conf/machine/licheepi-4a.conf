## conf/machine/licheepi-4a.conf
```bitbake
#@TYPE: Machine
#@NAME: licheepi-4a
#@SOC: Xuantie C910
#@DESCRIPTION: Machine configuration for the LicheePi 4A board

require include/c910.inc

# TUNE_FEATURES = "lp64d"
MACHINE_FEATURES = "ext2 ext4 kernel26"
MACHINE_ESSENTIAL_EXTRA_RDEPENDS += "genimage-th1520"

#============================================
# # SBI Configuration
# #RISCV_SBI_FDT ?= "th1520-beaglev-ahead.dtb"
# unset RISCV_SBI_PAYLOAD
#============================================

#============================================
# # Kernel Configuration
# KERNEL_DEVICETREE ?= "thead/th1520-beaglev-ahead.dtb"
# KERNEL_IMAGETYPE = "Image"
#============================================

#============================================
# # Uboot Configuration
UBOOT_MACHINE = "light_lpi4a_defconfig"
UBOOT_DTB_BINARY = "th1520-lichee-pi-4a.dtb"
#============================================

#============================================
# Image Configuration
# Note: currently just a fastboot deployment is supported
#       for which a separate boot.ext4 is generated
#IMAGE_BOOT_FILES:append = "fw_payload.bin"
# WKS_FILE ?= "beaglev-ahead.wks"
#============================================

#============================================
# Common Preferred Providers
PREFERRED_PROVIDER_virtual/kernel ?= "linux-licheepi"
PREFERRED_PROVIDER_virtual/bootloader ?= "u-boot-licheepi"
PREFERRED_PROVIDER_virtual/opensbi ?= "opensbi-licheepi"
#============================================
```
